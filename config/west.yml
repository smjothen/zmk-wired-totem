## config/west.yml
```yaml
manifest:
  remotes:
    - name: zmkfirmware
      url-base: https://github.com/zmkfirmware
    - name: urob
      url-base: https://github.com/urob
    - name: smjothen
      url-base: https://github.com/smjothen
  projects:
    - name: zmk
      remote: zmkfirmware
      revision: 0331b7d16e80954b807917f9323e59ffc1e3b626
      import: app/west.yml
    - name: zmk-helpers
      remote: urob
      revision: 7e0219e170ca2b919a5162412a1e6aa2d7b712aa
      path: modules/zmk/helpers
    - name: zmk-tri-state
      remote: urob
      revision: 2007896c6d5bfb519e8babccf8633841c5647d8b
      path: modules/zmk/tri-state
    - name: zmk-auto-layer
      remote: urob
      revision: dfa7c695ffde41ef8064245453595d50e198ae1d
      path: modules/zmk/auto-layer
    - name: zmk-adaptive-key
      remote: urob
      revision: 18cc2795a64ccb394d1a7b7d591a5bfe3f25924b
      path: modules/zmk/adaptive-key
    - name: zmk-leader-key
      remote: urob
      revision: 749f7faf65cc4105c82fbe64cfaa7e09a8a63605
      path: modules/zmk/leader-key
    - name: zmk-unicode
      remote: urob
      revision: 1a6dbc797a46c4a61c3c71a7a9d013a5d5aee49e
      path: modules/zmk/unicode
    - name: zmk-chordal-hold
      remote: smjothen
      revision: 3b15e130a737a173456c3d04651d3c22e403e762
      path: modules/zmk/chordal-hold
    - name: zmk-xiao-rp2040-led
      remote: smjothen
      revision: f47faac2def3e1570c01116502a6702f4de22084
      path: modules/zmk/xiao-rp2040-led
  self:
    path: config
```
